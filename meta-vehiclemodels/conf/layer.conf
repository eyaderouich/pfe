## meta-vehiclemodels/conf/layer.conf
```bitbake
# We have a conf and classes directory, add to BBPATH
BBPATH .= ":${LAYERDIR}"

# We have recipes-* directories, add to BBFILES
BBFILES += "${LAYERDIR}/recipes-*/*/*.bb \
            ${LAYERDIR}/recipes-*/*/*.bbappend"

BBFILE_COLLECTIONS += "meta-vehiclemodels"
BBFILE_PATTERN_meta-vehiclemodels = "^${LAYERDIR}/"
BBFILE_PRIORITY_meta-vehiclemodels = "6"

LAYERDEPENDS_meta-vehiclemodels = "core"
LAYERSERIES_COMPAT_meta-vehiclemodels = "kirkstone"
```
